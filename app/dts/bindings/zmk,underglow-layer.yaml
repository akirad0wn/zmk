## app/dts/bindings/zmk,underglow-layer.yaml
```yaml
description: |
  Allows defining a keymap composed of multiple layers

compatible: "zmk,underglow-layer"

properties:
  layer-base:
    type: array
    required: false
  layer-lower:
    type: array
    required: false
    
```
